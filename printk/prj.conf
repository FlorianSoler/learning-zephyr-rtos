## CMakeLists.txt
```
cmake_minimum_required(VERSION 3.20.0)

find_package(Zephyr REQUIRED HINTS $ENV{ZEPHYR_BASE})

project(printk)

target_sources(app PRIVATE src/main.c)
```

## prj.conf
```kconfig
CONFIG_GPIO=y
CONFIG_PRINTK=y
CONFIG_SERIAL=y
CONFIG_CONSOLE=y

CONFIG_BUILD_OUTPUT_UF2=y
```

## src/main.c
```c
#include <zephyr/kernel.h>

void main(void)
{
    while (1) {
        printk("HELLO\n");
        k_sleep(K_SECONDS(1));
    }
}
```
